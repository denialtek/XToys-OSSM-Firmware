#include "WebsocketManager.h"

namespace WebsocketManager {
    unsigned char CERT[] = {
        0x30, 0x82, 0x01, 0xa6, 0x30, 0x82, 0x01, 0x50, 0x02, 0x14, 0x14, 0x37,
        0xbe, 0x6a, 0x33, 0x60, 0x0a, 0x0a, 0xe3, 0x6e, 0x85, 0xa5, 0xcb, 0x70,
        0x20, 0x37, 0x08, 0x0a, 0x80, 0x07, 0x30, 0x0d, 0x06, 0x09, 0x2a, 0x86,
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        0x80, 0x0b, 0xd8, 0xca, 0x37, 0xb2
    };
    unsigned int CERT_LEN = 426;
    
    unsigned char KEY[] = {
        0x30, 0x82, 0x01, 0x55, 0x02, 0x01, 0x00, 0x30, 0x0d, 0x06, 0x09, 0x2a,
        0x86, 0x48, 0x86, 0xf7, 0x0d, 0x01, 0x01, 0x01, 0x05, 0x00, 0x04, 0x82,
        0x01, 0x3f, 0x30, 0x82, 0x01, 0x3b, 0x02, 0x01, 0x00, 0x02, 0x41, 0x00,
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        0x2b, 0xc8, 0x8e, 0x2a, 0x7f, 0x8c, 0x94, 0x6b, 0x8b
    };
    unsigned int KEY_LEN = 345;
    
    void (*msgReceivedCallback)(String);

    SSLCert cert = SSLCert(
        CERT, CERT_LEN,
        KEY, KEY_LEN
    );
    HTTPSServer secureServer = HTTPSServer(&cert, 443, MAX_CLIENTS);

    // Simple array to store the active clients:
    MessageHandler* activeClients[MAX_CLIENTS];

    void setup(void (*msgReceivedCallback)(String)) {
        WebsocketManager::msgReceivedCallback = msgReceivedCallback;

        // Initialize the slots
        for(int i = 0; i < MAX_CLIENTS; i++) activeClients[i] = nullptr;

        // For every resource available on the server, we need to create a ResourceNode
        // The ResourceNode links URL and HTTP method to a handler function
        ResourceNode * nodeRoot    = new ResourceNode("/", "GET", &handleRoot);
        ResourceNode * node404     = new ResourceNode("", "GET", &handle404);

        // Add the root node to the server
        secureServer.registerNode(nodeRoot);

        // The websocket handler can be linked to the server by using a WebsocketNode:
        // (Note that the standard defines GET as the only allowed method here,
        // so you do not need to pass it explicitly)
        WebsocketNode * messageNode = new WebsocketNode("/", &MessageHandler::create);

        // Adding the node to the server works in the same way as for all other nodes
        secureServer.registerNode(messageNode);

        // Finally, add the 404 not found node to the server.
        // The path is ignored for the default node.
        secureServer.setDefaultNode(node404);

        Serial.println("Starting server...");
        secureServer.start();
        if (secureServer.isRunning()) {
            Serial.print("Server ready. URL: wss://");
            Serial.println(WiFi.localIP());
        }
    }

    void loop() {
        // This call will let the server do its work
        secureServer.loop();
    }

    void handle404(HTTPRequest * req, HTTPResponse * res) {
        // Discard request body, if we received any
        // We do this, as this is the default node and may also server POST/PUT requests
        req->discardRequestBody();

        // Set the response status
        res->setStatusCode(404);
        res->setStatusText("Not Found");
        res->setHeader("Content-Type", "text/plain");
        res->println("Nothing here");
    }

    // In the create function of the handler, we create a new Handler and keep track
    // of it using the activeClients array
    WebsocketHandler * MessageHandler::create() {
        Serial.println("Creating new client!");
        MessageHandler * handler = new MessageHandler();
        for(int i = 0; i < MAX_CLIENTS; i++) {
            if (activeClients[i] == nullptr) {
                activeClients[i] = handler;
                break;
            }
        }
        return handler;
    }

    // When the websocket is closing, we remove the client from the array
    void MessageHandler::onClose() {
        for(int i = 0; i < MAX_CLIENTS; i++) {
            if (activeClients[i] == this) {
            activeClients[i] = nullptr;
            }
        }
    }

    // Finally, passing messages around. If we receive something, we send it to all
    // other clients
    void MessageHandler::onMessage(WebsocketInputStreambuf * inbuf) {
        // Get the input message
        std::ostringstream ss;
        std::string msg;
        ss << inbuf;
        msg = ss.str();
        msgReceivedCallback(msg.c_str());
    }

    // The following HTML code will present the chat interface.
    void handleRoot(HTTPRequest * req, HTTPResponse * res) {
        res->setHeader("Content-Type", "text/plain");
        res->print("SSL cert accepted. You can now close this tab.");
    }

    void sendMessage(String msg) {
        for(int i = 0; i < MAX_CLIENTS; i++) {
            if (activeClients[i] != nullptr) {
                activeClients[i]->send(msg.c_str(), WebsocketHandler::SEND_TYPE_TEXT);
                break;
            }
        }
    }
}